## main/Kconfig.projbuild
```kconfig
menu "ESP Matter Zigbee Bridge Example"

    choice ESP_MATTER_ZIGBEE_BRIDGE_BOARD_TYPE
       prompt "Zigbee Bridge board type"
        default ESP_MATTER_ZIGBEE_BRIDGE_BOARD_STANDALONE
        help
            The board running the Zigbee bridge.

        config ESP_MATTER_ZIGBEE_BRIDGE_BOARD_STANDALONE
            bool "Standalone DevKits"
            help
                Standalone ESP Wi-Fi DevKits (Such as ESP32/ESP32-S3) manually connected to the Zigbee RCP (Such as ESP32-H2)

        config ESP_MATTER_ZIGBEE_BRIDGE_BOARD_DEV_KIT
            bool "Zigbee gateway DevKit"
            help
                Integrated Zigbee gateway DevKit

    endchoice

    menu "Board Configuration"
        config PIN_TO_RCP_TX
            int "Pin to RCP TX"
            default 17 if ESP_MATTER_ZIGBEE_BRIDGE_BOARD_DEV_KIT
            default 4  if ESP_MATTER_ZIGBEE_BRIDGE_BOARD_STANDALONE

        config PIN_TO_RCP_RX
            int "PIN to RCP RX"
            default 18 if ESP_MATTER_ZIGBEE_BRIDGE_BOARD_DEV_KIT
            default 5  if ESP_MATTER_ZIGBEE_BRIDGE_BOARD_STANDALONE

        config PIN_TO_RCP_RESET
            int "GPIO to ESP32-H2 EN / RESET (for RCP OTA)"
            default 46
            help
                S3 GPIO wired to H2 EN. Held HIGH in normal operation so H2 runs.
                During RCP OTA, serial-flasher pulses this pin (with BOOT held low)
                to enter UART download mode.
                NOTE: ESP32-S3 GPIO46 is a strapping pin and may be input-only on
                some silicon; if H2 never resets for OTA, move EN to an output-
                capable GPIO (e.g. 6/7/8/9/10).

        config PIN_TO_RCP_BOOT
            int "GPIO to ESP32-H2 BOOT / IO9 (for RCP OTA)"
            default 3
            help
                S3 GPIO wired to H2 BOOT (GPIO9 strapping). Held HIGH in normal
                operation. During RCP OTA, serial-flasher holds this pin LOW while
                pulsing EN so H2 enters UART download mode.

    endmenu

    menu "Zigbee Gateway Configuration"
        config ZIGBEE_ANNCE_DELAY_MS
            int "Device announce debounce delay (ms)"
            default 500
            range 100 5000
            help
                Delay in milliseconds after receiving a Device Annce before starting
                endpoint discovery.  A longer delay gives the device more time to
                stabilize after joining the network.

        config ZIGBEE_MAX_ENDPOINT_PROBE
            int "Max endpoints to probe during discovery"
            default 5
            range 1 20
            help
                Maximum number of endpoints to probe sequentially when discovering
                a new device.  Zigbee HA/SE devices typically have 1-5 endpoints.

        config ZIGBEE_DISCOVERY_MAX_RETRIES
            int "Max discovery retries"
            default 3
            range 0 10
            help
                Maximum number of times to retry discovery when a Simple Descriptor
                request fails.  0 disables retries.  Each retry uses exponential
                backoff (base delay * 2^retry).

        config ZIGBEE_DISCOVERY_RETRY_BASE_MS
            int "Discovery retry base delay (ms)"
            default 1000
            range 200 10000
            help
                Base delay in milliseconds for discovery retry exponential backoff.
                Actual delay = base * 2^retry_count (e.g. 1s, 2s, 4s, 8s...).

        config ZIGBEE_MAX_HANDLERS
            int "Max ZCL device handlers"
            default 32
            range 8 64
            help
                Maximum number of registered ZCL device handlers.  Each handler
                corresponds to one cluster ID.  Typical gateways need 8-16 handlers.

        config ZIGBEE_METRICS_DUMP_INTERVAL_S
            int "Metrics auto-dump interval (seconds, 0=disable)"
            default 0
            range 0 3600
            help
                Periodically dump runtime metrics to the log.  Set to 0 to disable
                automatic dumps (dump manually via zcl_metrics_dump()).
    endmenu

    menu "OTA Firmware Upgrade"
        config OTA_FW_UPGRADE_URL
            string "Firmware upgrade URL"
            default "https://example.com/firmware.bin"
            help
                HTTPS URL pointing to the latest firmware binary.
                Must use HTTPS in production for security.

        config OTA_HTTP_TIMEOUT_MS
            int "HTTP timeout (ms) for OTA download"
            default 30000
            range 5000 120000
            help
                Timeout for each HTTP request during OTA check/download.

        config OTA_HTTP_BUFFER_SIZE
            int "HTTP buffer size for OTA download"
            default 4096
            range 1024 16384
            help
                Buffer size for HTTP OTA download.  Larger buffers increase
                speed at the cost of RAM (buffer is stack-allocated during download).

        config OTA_AUTO_CHECK_HOURS
            int "Auto OTA check interval (hours, 0=disable)"
            default 0
            range 0 168
            help
                Periodically check for new firmware.  Set to 0 to disable.
                Recommended: 24 (daily) for production.

        config OTA_HTTPS_CERT_PEM
            string "HTTPS server certificate (PEM)"
            default ""
            help
                PEM-encoded server certificate for TLS verification.
                Leave empty to disable TLS verification (development only).

        config GATEWAY_RCP_OTA
            bool "Flash official ESP32-H2 RCP during Matter OTA"
            default y
            help
                Matter OTA payload is a combined image: H2 ot_rcp (bootloader +
                partition + app) followed by the S3 gateway firmware. During
                download the S3 pauses Zigbee UART, serial-flashes the H2, then
                writes its own image to the inactive ota_0/ota_1 slot.
                Requires PIN_TO_RCP_RESET and PIN_TO_RCP_BOOT wired.
                Host-only zigbee_bridge.bin still works if the payload starts
                with an ESP image magic (0xE9).

        config RCP_OTA_BUILD_DIR
            depends on GATEWAY_RCP_OTA
            string "Prebuilt official ot_rcp build directory"
            default "$(IDF_PATH)/examples/openthread/ot_rcp/build"
            help
                Directory that contains esp_ot_rcp.bin, bootloader/bootloader.bin,
                partition_table/partition-table.bin, flash_args and rcp_version.
                Build ot_rcp for esp32h2 with OPENTHREAD_NCP_VENDOR_HOOK first.
    endmenu

endmenu
```

## rcp_test/sdkconfig.defaults
```kconfig
# Zigbee 配置
CONFIG_ZB_ENABLED=y
CONFIG_ZB_ZCZR=y
CONFIG_ZB_RADIO_MACSPLIT_UART=y

# OpenThread Spinel 配置（RCP 通信必需）
CONFIG_OPENTHREAD_SPINEL_ONLY=y
CONFIG_OPENTHREAD_SPINEL_RX_FRAME_BUFFER_SIZE=2048
CONFIG_OPENTHREAD_SPINEL_MAC_MAX_CSMA_BACKOFFS_DIRECT=4

# Flash 大小
CONFIG_ESPTOOLPY_FLASHSIZE_4MB=y

# 自定义分区表（Zigbee 需要 zb_storage 分区）
CONFIG_PARTITION_TABLE_CUSTOM=y
CONFIG_PARTITION_TABLE_CUSTOM_FILENAME="partitions.csv"
```

## sdkconfig.defaults.esp32s3
```kconfig
CONFIG_IDF_TARGET="esp32s3"

# Zboss
CONFIG_ZB_HOST=y

# System event stack size
CONFIG_ESP_SYSTEM_EVENT_TASK_STACK_SIZE=3072

# Increase timer stack size
CONFIG_FREERTOS_TIMER_TASK_STACK_DEPTH=4096

# PSRAM: N16R8 = 16MB flash + 8MB octal PSRAM
# 参考 esp-matter examples/*/sdkconfig.defaults.ram_optimization
CONFIG_SPIRAM=y
CONFIG_SPIRAM_MODE_OCT=y
CONFIG_SPIRAM_SPEED_80M=y
CONFIG_SPIRAM_USE_MALLOC=y
CONFIG_SPIRAM_BOOT_INIT=y
CONFIG_SPIRAM_MALLOC_ALWAYSINTERNAL=512
CONFIG_SPIRAM_MALLOC_RESERVE_INTERNAL=16384
CONFIG_SPIRAM_ALLOW_BSS_SEG_EXTERNAL_MEMORY=y
CONFIG_SPIRAM_TRY_ALLOCATE_WIFI_LWIP=y
CONFIG_BT_NIMBLE_MEM_ALLOC_MODE_EXTERNAL=y
CONFIG_ESP_MATTER_MEM_ALLOC_MODE_EXTERNAL=y
CONFIG_MBEDTLS_EXTERNAL_MEM_ALLOC=y
```
